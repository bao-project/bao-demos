/ {
    bao-ipc@f0000000 {
        compatible = "bao,ipcshmem";
        reg = <0xf0000000 0x0004000>;
		read-channel = <0x0 0x2000>;
		write-channel = <0x2000 0x2000>;
        interrupts = <52 1 1>;
        interrupt-parent = <&aplic>;
        id = <0>;
        status = "okay";
    };
};
