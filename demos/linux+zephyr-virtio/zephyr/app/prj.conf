## CMakeLists.txt
```
cmake_minimum_required(VERSION 3.20.0)

find_package(Zephyr)
project(bao-virtio-console-demo)

target_sources(app PRIVATE src/main.c)
```

## prj.conf
```kconfig
# Code and read-only data stay in the VM's private memory region (zephyr,flash)
# while all RAM is placed in the shared memory region (zephyr,sram), so that
# the VirtIO backend can access the virtqueues and the driver buffers.
CONFIG_XIP=y

CONFIG_SERIAL=y
CONFIG_UART_INTERRUPT_DRIVEN=y
CONFIG_VIRTIO=y
CONFIG_UART_VIRTIO_CONSOLE=y

# Report driver errors on the console
CONFIG_LOG=y
CONFIG_LOG_MODE_MINIMAL=y

# The VirtIO network device, with a static address on the network of the
# backend VM. Its driver is enabled by the virtio,net devicetree node.
CONFIG_NETWORKING=y
CONFIG_NET_L2_ETHERNET=y
CONFIG_ETH_DRIVER=y
CONFIG_NET_IPV4=y
CONFIG_NET_IPV6=n
CONFIG_NET_CONFIG_SETTINGS=y
CONFIG_NET_CONFIG_NEED_IPV4=y
CONFIG_NET_CONFIG_MY_IPV4_ADDR="192.168.42.16"
CONFIG_NET_CONFIG_MY_IPV4_NETMASK="255.255.255.0"
CONFIG_TEST_RANDOM_GENERATOR=y

# The VirtIO block device. Its driver is enabled by the virtio,blk devicetree
# node.
CONFIG_DISK_ACCESS=y
```

## boards/baovm_qemu-aarch64-virt.conf
```kconfig
# Run Zephyr on a single CPU. Zephyr's AArch64 SMP boot elects the primary
# CPU through a variable in .data, which an XIP image only initializes later,
# when the data section is copied to RAM.
CONFIG_SMP=n
CONFIG_MP_MAX_NUM_CPUS=1

# The XIP layout places the code and the RAM in two distant regions and the
# VirtIO device is mapped at run time: more translation tables are needed than
# the default.
CONFIG_MAX_XLAT_TABLES=16
```

## src/main.c
```c
/*
 * SPDX-License-Identifier: Apache-2.0
 *
 * Bao demo: Zephyr as a VirtIO console frontend.
 *
 * The VirtIO console is served by a backend running in another VM (Linux
 * with the Bao VirtIO device model). Two threads periodically write to the
 * VirtIO console, everything received from it is printed on the UART console,
 * and everything typed on the UART console is forwarded to the VirtIO console.
 */

#include <zephyr/kernel.h>
#include <zephyr/device.h>
#include <zephyr/drivers/uart.h>
#include <zephyr/sys/printk.h>
#include <zephyr/devicetree.h>
#include <zephyr/storage/disk_access.h>
#include <string.h>

#define LINE_SIZE 128

static const struct device *const uart = DEVICE_DT_GET(DT_CHOSEN(zephyr_console));
static const struct device *const virtio_mmio = DEVICE_DT_GET(DT_NODELABEL(virtio_mmio0));
static const struct device *const vcon = DEVICE_DT_GET(DT_NODELABEL(virtio_console0));

/* Characters typed on the UART, waiting to be sent to the VirtIO console */
K_MSGQ_DEFINE(uart_rx_msgq, sizeof(char), 64, 1);

/* Serializes writes to the VirtIO console */
K_MUTEX_DEFINE(vcon_tx_lock);

static struct k_thread thread1_data;
static struct k_thread thread2_data;
static struct k_thread forward_thread_data;

K_THREAD_STACK_DEFINE(thread1_stack, 1024);
K_THREAD_STACK_DEFINE(thread2_stack, 1024);
K_THREAD_STACK_DEFINE(forward_thread_stack, 1024);

static void vcon_write(const char *s, size_t len)
{
	k_mutex_lock(&vcon_tx_lock, K_FOREVER);
	for (size_t i = 0; i < len; i++) {
		uart_poll_out(vcon, s[i]);
	}
	k_mutex_unlock(&vcon_tx_lock);
}

/* Periodically sends messages to the VirtIO console */
static void counter_thread(void *arg1, void *arg2, void *arg3)
{
	size_t id = (size_t)arg1;
	size_t counter = 0;
	char msg[32];

	while (1) {
		int len = snprintk(msg, sizeof(msg), "Thread%zu: %zu\r\n", id, counter++);

		vcon_write(msg, len);
		k_msleep(1000);
	}
}

/* Forwards characters typed on the UART to the VirtIO console */
static void forward_thread(void *arg1, void *arg2, void *arg3)
{
	char c;

	while (1) {
		k_msgq_get(&uart_rx_msgq, &c, K_FOREVER);
		vcon_write(&c, 1);
	}
}

/* Called on UART receive interrupts */
static void uart_rx_handler(const struct device *dev, void *user_data)
{
	char c;

	uart_irq_update(dev);

	while (uart_irq_rx_ready(dev) && uart_fifo_read(dev, &c, 1) == 1) {
		k_msgq_put(&uart_rx_msgq, &c, K_NO_WAIT);
	}
}

/* Called on VirtIO console receive interrupts: prints each received line */
static void vcon_rx_handler(const struct device *dev, void *user_data)
{
	static char line[LINE_SIZE];
	static size_t len;
	char c;

	while (uart_fifo_read(dev, &c, 1) == 1) {
		if (c == '\r' || c == '\n') {
			line[len] = '\0';
			printk("message from the virtio console: %s\n", line);
			len = 0;
		} else if (len < LINE_SIZE - 1) {
			line[len++] = c;
		}
	}
}

#if DT_HAS_COMPAT_STATUS_OKAY(virtio_blk)
#define SECTOR_SIZE 512
#define DISK_NAME   DT_PROP(DT_COMPAT_GET_ANY_STATUS_OKAY(virtio_blk), disk_name)

/*
 * Prints the message in the first sector of the VirtIO block device and
 * answers in the second one.
 */
static void block_device_demo(void)
{
	static uint8_t sector[SECTOR_SIZE];

	if (disk_access_init(DISK_NAME) != 0 || disk_access_read(DISK_NAME, sector, 0, 1) != 0) {
		printk("failed to read the virtio block device!\n");
		return;
	}

	sector[SECTOR_SIZE - 1] = '\0';
	printk("message from the virtio block device: %s", sector);

	memset(sector, 0, SECTOR_SIZE);
	strcpy((char *)sector, "Hello from Zephyr\n");
	if (disk_access_write(DISK_NAME, sector, 1, 1) != 0) {
		printk("failed to write to the virtio block device!\n");
	}
}
#endif

int main(void)
{
	printk("Bao Zephyr VirtIO console demo\n");

	/*
	 * The VirtIO MMIO accesses are forwarded by Bao to the backend VM, so
	 * initialization blocks until the backend (bao-virtio-dm) is running.
	 */
	printk("Initializing the virtio console (waiting for the backend)...\n");
	if (device_init(virtio_mmio) != 0 || device_init(vcon) != 0) {
		printk("virtio console initialization failed!\n");
		return -1;
	}
	printk("virtio console initialized\n");

#if DT_HAS_COMPAT_STATUS_OKAY(virtio_blk)
	/* The demos with a virtio block device exchange messages through it */
	block_device_demo();
#endif

	uart_irq_callback_set(vcon, vcon_rx_handler);
	uart_irq_rx_enable(vcon);

	uart_irq_callback_set(uart, uart_rx_handler);
	uart_irq_rx_enable(uart);

	k_thread_create(&forward_thread_data, forward_thread_stack,
			K_THREAD_STACK_SIZEOF(forward_thread_stack),
			forward_thread, NULL, NULL, NULL,
			1, 0, K_NO_WAIT);

	k_thread_create(&thread1_data, thread1_stack,
			K_THREAD_STACK_SIZEOF(thread1_stack),
			counter_thread, (void *)1, NULL, NULL,
			1, 0, K_NO_WAIT);

	k_thread_create(&thread2_data, thread2_stack,
			K_THREAD_STACK_SIZEOF(thread2_stack),
			counter_thread, (void *)2, NULL, NULL,
			1, 0, K_NO_WAIT);

	return 0;
}
```
