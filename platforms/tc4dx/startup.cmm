B::

TOOLBAR   ON
STATUSBAR ON
FramePOS 274.29,1.8,,,Maximized
WinPAGE.RESet

WinPAGE.Create P000
WinCLEAR

WinPOS 0.0 0.0 78. 32. 14. 0. W008
PEDIT "./platforms/tc4dx/tc4_demo.cmm"
DO "./platforms/tc4dx/tc4_demo.cmm"


WinPOS 2.4286 37.8 75. 16. 0. 0. W002
Register

WinPOS 195.57 43.067 75. 10. 0. 1. W003
WinTABS 20. 250.
CORE.List

WinPOS 81.571 43.133 110. 8. 0. 0. W005
Var.Watch


WinPOS 198.57 0.0 72. 27. 5. 0. W006
Frame /Locals /Caller

WinPOS 198.14 31.8 73. 5. 23. 1. W000
WinTABS 13. 0. 0. 0. 0. 0. 0. 0. 0. 22.
Break.List

WinPOS 81.286 0.0 114. 37. 13. 1. W001
WinTABS 10. 10. 25.
List

WinPAGE.select P000

ENDDO
