## guests/linux/buildroot/external/Config.in
```kconfig
source "$BR2_EXTERNAL_BAO_DEMOS_PATH/package/bao-drivers/Config.in"
source "$BR2_EXTERNAL_BAO_DEMOS_PATH/package/bao-virtio-dm/Config.in"
```

## guests/linux/buildroot/external/package/bao-drivers/Config.in
```kconfig
config BR2_PACKAGE_BAO_DRIVERS
    bool "bao-drivers"
    depends on BR2_LINUX_KERNEL
    help
      This package builds Linux Bao's modules for IPC and IODISPATCHER.
```

## guests/linux/buildroot/external/package/bao-virtio-dm/Config.in
```kconfig
config BR2_PACKAGE_BAO_VIRTIO_DM
    bool "bao-virtio-dm"
    depends on BR2_PACKAGE_HOST_RUSTC_TARGET_ARCH_SUPPORTS
    select BR2_PACKAGE_HOST_RUST_BIN
    help
      The Bao virtio device model (Rust).

      This package builds the bao-virtio-dm Rust crate
      using the vendored Cargo dependencies in the source tree.
```

## guests/nuttx/boards/e3650/configs/bao_guest/defconfig
```kconfig
# ##############################################################################
#
# Licensed to the Apache Software Foundation (ASF) under one or more contributor
# license agreements.  See the NOTICE file distributed with this work for
# additional information regarding copyright ownership.  The ASF licenses this
# file to you under the Apache License, Version 2.0 (the "License").you may not
# use this file except in compliance with the License.  You may obtain a copy of
# the License at
#
# http://www.apache.org/licenses/LICENSE-2.0
#
# Unless required by applicable law or agreed to in writing, software
# distributed under the License is distributed on an "AS IS" BASIS, WITHOUT
# WARRANTIES OR CONDITIONS OF ANY KIND, either express or implied.  See the
# License for the specific language governing permissions and limitations under
# the License.
#
# ##############################################################################
CONFIG_ARCH="arm"
CONFIG_ARCH_ARM=y
CONFIG_ARCH_BOARD_CUSTOM=y
CONFIG_ARCH_BOARD_CUSTOM_DIR="../../../guests/nuttx/boards/e3650"
CONFIG_ARCH_BOARD_CUSTOM_DIR_RELPATH=y
CONFIG_ARCH_BOARD_CUSTOM_NAME="e3650_dev_kit"
CONFIG_ARCH_CHIP_ARM_CUSTOM=y
CONFIG_ARCH_CHIP_CUSTOM=y
CONFIG_ARCH_CHIP_CUSTOM_DIR="../../../guests/nuttx/chips/e3650"
CONFIG_ARCH_CHIP_CUSTOM_DIR_RELPATH=y
CONFIG_ARCH_CHIP_CUSTOM_NAME=""
CONFIG_ARCH_CHIP_E3650=y
CONFIG_ARCH_CHIP_E3650_GICD_BASE=0xF4000000
CONFIG_ARCH_CHIP_E3650_GICR_BASE=0xF4100000
CONFIG_SYS_CLOCK_HW_CYCLES_PER_SEC=24000000
CONFIG_ARCH_HAVE_DEBUG=y
CONFIG_ARCH_FPU=n
CONFIG_ARCH_INTERRUPTSTACK=4096
CONFIG_IDLETHREAD_STACKSIZE=4096
CONFIG_ARCH_SETJMP_H=y
# CONFIG_ARM_THUMB is not set
CONFIG_ARCH_STACKDUMP=y
CONFIG_BOARD_LOOPSPERMSEC=99369
CONFIG_BUILTIN=y
CONFIG_BOOT_RUNFROMISRAM=y
CONFIG_SMP=y
CONFIG_SMP_NCPUS=2
CONFIG_DEBUG_ASSERTIONS=y
CONFIG_DEBUG_FEATURES=y
CONFIG_DEBUG_FULLOPT=y
CONFIG_DEBUG_SYMBOLS=y
CONFIG_DEV_ZERO=y
CONFIG_EXAMPLES_HELLO=y
CONFIG_EXPERIMENTAL=y
CONFIG_INIT_ENTRYPOINT="nsh_main"
CONFIG_LIBC_MEMFD_ERROR=y
CONFIG_NDEBUG=y
CONFIG_BOARDCTL=y
CONFIG_BOARD_LATE_INITIALIZE=y
CONFIG_NSH_ARCHINIT=y
CONFIG_NSH_BUILTIN_APPS=y
CONFIG_NSH_FILEIOSIZE=512
CONFIG_NSH_READLINE=y
CONFIG_NSH_SC=y
CONFIG_NSH_BUILTIN_AS_COMMAND=y
CONFIG_NSH_CMDOPT_HEXDUMP=n
CONFIG_PREALLOC_TIMERS=4
CONFIG_RAM_SIZE=1114112
CONFIG_RAM_START=0x00BA0000
CONFIG_READLINE_CMD_HISTORY=y
CONFIG_SCHED_WAITPID=y
CONFIG_SCHED_EVENTS=y
CONFIG_SPINLOCK=y
CONFIG_STACK_COLORATION=y
CONFIG_START_MONTH=3
CONFIG_START_YEAR=2016
CONFIG_SYMTAB_ORDEREDBYNAME=y
CONFIG_SYSLOG_BUFFER=y
CONFIG_SYSLOG_DEVPATH="/dev/ttyS0"
CONFIG_SYSLOG_INTBUFFER=y
CONFIG_SYSLOG_MAX_CHANNELS=2
CONFIG_SYSTEM_NSH=y
CONFIG_UART0_SERIAL_CONSOLE=y
CONFIG_USEC_PER_TICK=1000
CONFIG_RAW_BINARY=y
# CONFIG_BOARD_EARLY_INITIALIZE is not set
# CONFIG_FS_PROCFS is not set
CONFIG_SYSTEM_TRACE=y
CONFIG_LIBC_IPv4_ADDRCONV=y
CONFIG_DEBUG_WARNING_AS_ERROR=y
CONFIG_EXAMPLES_BAO_SHMEM=y
```

## guests/nuttx/chips/e3650/Kconfig
```kconfig
#
# For a description of the syntax of this configuration file,
# see the file kconfig-language.txt in the NuttX tools repository.
#

if ARCH_CHIP_CUSTOM

menu "E3650 Chip Selection"

choice
	prompt "E3650 Core Configuration"
	default ARCH_CHIP_E3650

config ARCH_CHIP_E3650
	bool "E3650 Processor (Cortex-r52)"
	select ARCH_CORTEXR52
	select ARCH_HAVE_FETCHADD
	select ARCH_HAVE_FPU
	select ARCH_HAVE_LOWVECTORS
	select ARCH_HAVE_MULTICPU
	select ARCH_HAVE_TESTSET
	select ARCH_HAVE_RESET
	select ARM_HAVE_NEON
	select ARM_USE_CUSTOM_SYS_STACK
	select ARMV8R_HAVE_DECODEFIQ
	select ARMV8R_DECODEFIQ
	select ARMV8R_HAVE_GICv3
	select ARMV8R_STRING_FUNCTION
	select ARCH_HAVE_PERF_EVENTS
	select ARCH_DCACHE
	select ARCH_ICACHE
	select ARCH_HAVE_IRQPRIO
	select HRTIMER
	select SYSTEM_TIME64
	select ARCH_IRQPRIO
	select STACK_OVERFLOW_CHECK

endchoice # E3650 Core Configuration

if ARCH_CHIP_E3650

config E3650_UART0
	bool "E3650 UART0"
	default y
	depends on !DISABLE_DRIVERS
	select UART0_SERIALDRIVER
	select ARCH_HAVE_SERIAL_TERMIOS

config ARCH_CHIP_E3650_GICD_BASE
	hex "E3650 Processor (Cortex-r52) GIC Distributor Base"
	default 0xF4000000

config ARCH_CHIP_E3650_GICR_BASE
	hex "E3650 Processor (Cortex-r52) GIC Re-distributor Base"
	default 0xF4100000

config SYS_CLOCK_HW_CYCLES_PER_SEC
	int "system clock frequency"
	default 100000000
	---help---
		The system clock frequency in general is used to trigger system tick

endif # ARCH_CHIP_E3650

endmenu # E3650 Chip Selection

endif # ARCH_CHIP_CUSTOM
```

## guests/zephyr/boards/arm/baovm_fvp-a-aarch32/board.yml
```yaml
board:
  name: baovm_fvp-a-aarch32
  full_name: BASE RevC AEMv8A Fixed Virtual Platforms
  vendor: arm
  socs:
  - name: fvp_aemv8r_aarch32
```

## guests/zephyr/boards/arm/baovm_fvp-r-aarch32/Kconfig.baovm_fvp-r-aarch32
```kconfig
# Copyright (c) 2021 Arm Limited (or its affiliates). All rights reserved.
# Copyright (c) 2022 IoT.bzh
# SPDX-License-Identifier: Apache-2.0

config BOARD_BAOVM_FVP_R_AARCH32
	select SOC_FVP_AEMV8R_AARCH32
```

## guests/zephyr/boards/arm/baovm_fvp-r-aarch32/board.yml
```yaml
board:
  name: baovm_fvp-r-aarch32
  full_name: FVP Emulation FVP_BaseR_AEMv8R (SMP)
  vendor: arm
  socs:
  - name: fvp_aemv8r_aarch32
    variants:
    - name: 'smp'
```

## guests/zephyr/boards/arm/baovm_mps3-an536/board.yml
```yaml
board:
  name: baovm_mps3-an536
  full_name: Arm MPS3 AN536
  vendor: arm
  socs:
  - name: fvp_aemv8r_aarch32
    variants:
    - name: 'smp'
```

## guests/zephyr/boards/arm/baovm_s32z270/Kconfig.baovm_s32z270
```kconfig
# Copyright (c) 2021 Arm Limited (or its affiliates). All rights reserved.
# Copyright (c) 2022 IoT.bzh
# SPDX-License-Identifier: Apache-2.0

config BOARD_BAOVM_S32Z270
	bool
	select SOC_S32Z270_RTU0 if BOARD_BAOVM_S32Z270_S32Z270_RTU0
```

## guests/zephyr/boards/arm/baovm_s32z270/baovm_s32z270_defconfig
```kconfig
# Copyright (c) 2021 Arm Limited (or its affiliates). All rights reserved.
# Copyright (c) 2022 IoT.bzh
# SPDX-License-Identifier: Apache-2.0

CONFIG_ISR_STACK_SIZE=512

# Enable Timer and Sys clock
CONFIG_SYS_CLOCK_TICKS_PER_SEC=1000
CONFIG_SYS_CLOCK_HW_CYCLES_PER_SEC=8000000

# Enable UART driver
CONFIG_SERIAL=y

# Enable serial port
CONFIG_UART_INTERRUPT_DRIVEN=y

# Enable console
CONFIG_CONSOLE=y
CONFIG_UART_CONSOLE=y

# Enable MPU
CONFIG_ARM_MPU=y

CONFIG_XIP=y
```

## guests/zephyr/boards/arm/baovm_s32z270/board.yml
```yaml
board:
  name: baovm_s32z270
  full_name: X-S32Z27X-DC (DC2)
  vendor: nxp
  revision:
    format: letter
    default: B
    revisions:
      - name: B
      - name: D
  socs:
    - name: s32z270
```

## guests/zephyr/boards/arm64/baovm_fvp-r/Kconfig.baovm_fvp-r
```kconfig
# Copyright (c) 2021 Arm Limited (or its affiliates). All rights reserved.
# SPDX-License-Identifier: Apache-2.0

config BOARD_BAOVM_FVP_R
	select SOC_FVP_AEMV8R_AARCH64
```

## guests/zephyr/boards/arm64/baovm_fvp-r/board.yml
```yaml
board:
  name: baovm_fvp-r
  full_name: FVP Emulation FVP_BaseR_AEMv8R (SMP)
  vendor: arm
  socs:
  - name: fvp_aemv8r_aarch64
    variants:
    - name: 'smp'
```

## guests/zephyr/boards/arm64/baovm_qemu-aarch64-virt/Kconfig.baovm_qemu-aarch64-virt
```kconfig
# Copyright (c) 2019 Carlo Caione <ccaione@baylibre.com>
# SPDX-License-Identifier: Apache-2.0

config BOARD_BAOVM_QEMU_AARCH64_VIRT
	select SOC_QEMU_CORTEX_A53
```

## guests/zephyr/boards/arm64/baovm_qemu-aarch64-virt/baovm_qemu-aarch64-virt_defconfig
```kconfig
CONFIG_THREAD_STACK_INFO=y

# Enable Timer and Sys clock
CONFIG_SYS_CLOCK_TICKS_PER_SEC=1000
CONFIG_ARM_ARCH_TIMER=y


# Cache management
CONFIG_CACHE_MANAGEMENT=y

# Enable UART driver
CONFIG_SERIAL=y

# Enable console
CONFIG_CONSOLE=y
CONFIG_UART_CONSOLE=y

# Enable serial port
CONFIG_UART_INTERRUPT_DRIVEN=y

# Enable TFA
CONFIG_ARMV8_A_NS=y

# Enable SMP
CONFIG_SMP=y
CONFIG_MP_MAX_NUM_CPUS=2
CONFIG_CACHE_MANAGEMENT=y
CONFIG_TIMEOUT_64BIT=y
CONFIG_MAX_THREAD_BYTES=3

# PSCI is supported
CONFIG_PM_CPU_OPS=y
CONFIG_PM_CPU_OPS_PSCI=y

# Avoid timing skew in tests
CONFIG_QEMU_ICOUNT=y
CONFIG_QEMU_ICOUNT_SHIFT=7
```

## guests/zephyr/boards/arm64/baovm_qemu-aarch64-virt/board.yml
```yaml
board:
  name: baovm_qemu-aarch64-virt
  full_name: QEMU Emulation for ARM Cortex-A53
  vendor: arm
  socs:
  - name: qemu_cortex_a53
    variants:
    - name: smp
    - name: xip
```

## guests/zephyr/boards/arm64/baovm_rpi4/Kconfig.baovm_rpi4
```kconfig
# Copyright (c) 2019 Carlo Caione <ccaione@baylibre.com>
# Copyright (c) 2023 Yan-Jie Wang <yanjiewtw@gmail.com>
# SPDX-License-Identifier: Apache-2.0

config BOARD_BAOVM_RPI4
	select SOC_BCM2711
```

## guests/zephyr/boards/arm64/baovm_rpi4/Kconfig.board
```kconfig
# Copyright (c) 2019 Carlo Caione <ccaione@baylibre.com>
# Copyright (c) 2023 Yan-Jie Wang <yanjiewtw@gmail.com>
# SPDX-License-Identifier: Apache-2.0

config BOARD_RASPBERRY_PI_4B
	bool "Raspberry Pi 4B"
	depends on SOC_BCM2711
	select ARM64
```

## guests/zephyr/boards/arm64/baovm_rpi4/Kconfig.defconfig
```kconfig
# Copyright (c) 2019 Carlo Caione <ccaione@baylibre.com>
# Copyright (c) 2023 Yan-Jie Wang <yanjiewtw@gmail.com>
# SPDX-License-Identifier: Apache-2.0

if BOARD_RASPBERRY_PI_4B

config BUILD_OUTPUT_BIN
	default y

config BOARD
	default "raspberry_pi_4b"

endif # BOARD_RASPBERRY_PI_4B
```

## guests/zephyr/boards/arm64/baovm_rpi4/baovm_rpi4_defconfig
```kconfig
# CONFIG_SOC_BCM2711=y
# CONFIG_BOARD_RASPBERRY_PI_4B=y

# Platform Configuration
CONFIG_ARM64_VA_BITS_36=y
CONFIG_ARM64_PA_BITS_36=y

# Enable UART driver
CONFIG_SERIAL=y

# Enable console
CONFIG_CONSOLE=y
CONFIG_UART_CONSOLE=y

# Enable serial port
CONFIG_UART_INTERRUPT_DRIVEN=y

# Enable SMP
CONFIG_SMP=y
CONFIG_MP_MAX_NUM_CPUS=2
CONFIG_CACHE_MANAGEMENT=y
CONFIG_TIMEOUT_64BIT=y
CONFIG_MAX_THREAD_BYTES=3

# PSCI is supported
CONFIG_PM_CPU_OPS=y
CONFIG_PM_CPU_OPS_PSCI=y
```

## guests/zephyr/boards/arm64/baovm_rpi4/board.yml
```yaml
board:
  name: baovm_rpi4
  full_name: Raspberry Pi 4 Model B (Cortex-A72)
  vendor: raspberrypi
  socs:
  - name: bcm2711
```
