## guests/zephyr/boards/riscv/baovm_qemu-riscv32-virt/Kconfig.baovm_qemu-riscv32-virt
```kconfig
config BOARD_BAOVM_QEMU_RISCV32_VIRT
	select SOC_QEMU_VIRT_RISCV32
	select RISCV_HAS_AIA
```

## guests/zephyr/boards/riscv/baovm_qemu-riscv32-virt/board.yml
```yaml
board:
  name: baovm_qemu-riscv32-virt
  full_name: Bao guest on QEMU virt (RV32)
  vendor: bao
  socs:
    - name: qemu_virt_riscv32
```

## guests/zephyr/boards/riscv/baovm_qemu-riscv64-virt-plic/Kconfig.baovm_qemu-riscv64-virt-plic
```kconfig
# SPDX-License-Identifier: Apache-2.0

config BOARD_BAOVM_QEMU_RISCV64_VIRT_PLIC
	select SOC_QEMU_VIRT_RISCV64
```

## guests/zephyr/boards/riscv/baovm_qemu-riscv64-virt-plic/board.yml
```yaml
board:
  name: baovm_qemu-riscv64-virt-plic
  full_name: Bao VM on QEMU RISC-V 64 virt (PLIC)
  vendor: bao
  socs:
  - name: qemu_virt_riscv64
```

## guests/zephyr/boards/riscv/baovm_qemu-riscv64-virt/Kconfig.baovm_qemu-riscv64-virt
```kconfig
config BOARD_BAOVM_QEMU_RISCV64_VIRT
	select SOC_QEMU_VIRT_RISCV64
	select RISCV_HAS_AIA
```

## guests/zephyr/boards/riscv/baovm_qemu-riscv64-virt/board.yml
```yaml
board:
  name: baovm_qemu-riscv64-virt
  full_name: Bao guest on QEMU virt (RV64)
  vendor: bao
  socs:
    - name: qemu_virt_riscv64
```

## platforms/k3-com260/bao.its
```
/dts-v1/;

/ {
	description = "Bao hypervisor for SpacemiT K3 (CoM260 Kit)";
	#address-cells = <2>;

	images {
		bao {
			description = "Bao hypervisor + guest(s)";
			data = /incbin/("./bao.bin");
			type = "kernel";
			arch = "riscv";
			os = "linux";
			compression = "none";
			/* Fixed, page-aligned load/entry inside DRAM (kernel_addr_r from the
			 * vendor U-Boot env). U-Boot's RISC-V bootm enters with a0 = boot
			 * hart id, a1 = FDT (Bao ignores a1). */
			load = <0x1 0x40000000>;
			entry = <0x1 0x40000000>;
			hash {
				algo = "crc32";
			};
		};
	};

	configurations {
		default = "conf-bao";
		conf-bao {
			description = "Boot Bao";
			kernel = "bao";
		};
	};
};
```

## platforms/k3-com260/boot_scr.its
```
/dts-v1/;

/*
 * FIT wrapper for boot.cmd. This board's U-Boot has the legacy image format
 * disabled (CONFIG_LEGACY_IMAGE_FORMAT unset), so a classic
 * `mkimage -T script` boot.scr is rejected by `source` with
 * "Wrong image format" - the script must be a FIT, just like bao.itb.
 * The `default` property under /images lets a plain `source ${addr}`
 * (no :unit-name suffix) find the script.
 */

/ {
	description = "Bao boot script (FIT, this U-Boot rejects legacy uImages)";
	#address-cells = <1>;

	images {
		default = "script";

		script {
			description = "boot.cmd";
			data = /incbin/("boot.cmd");
			type = "script";
			compression = "none";
		};
	};
};
```
